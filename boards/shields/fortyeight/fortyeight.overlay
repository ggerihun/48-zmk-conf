#include <dt-bindings/zmk/matrix_transform.h>

/ {
    chosen {
        zmk,kscan = &default_kscan;
        zmk,matrix_transform = &default_transform;
    };

    default_kscan: kscan {
        compatible = "zmk,kscan-gpio-matrix";
        label = "default_kscan";
        diode-direction = "col2row";

        row-gpios = <&gpio0 21 GPIO_ACTIVE_LOW>,
                    <&gpio0 20 GPIO_ACTIVE_LOW>,
                    <&gpio0 19 GPIO_ACTIVE_LOW>,
                    <&gpio0 18 GPIO_ACTIVE_LOW>;

        col-gpios = <&gpio1 10 GPIO_ACTIVE_LOW>,
                    <&gpio1 11 GPIO_ACTIVE_LOW>,
                    <&gpio1 12 GPIO_ACTIVE_LOW>,
                    <&gpio1 13 GPIO_ACTIVE_LOW>,
                    <&gpio1 14 GPIO_ACTIVE_LOW>,
                    <&gpio1 15 GPIO_ACTIVE_LOW>,
                    <&gpio0 17 GPIO_ACTIVE_LOW>,
                    <&gpio0 16 GPIO_ACTIVE_LOW>,
                    <&gpio0 15 GPIO_ACTIVE_LOW>,
                    <&gpio0 14 GPIO_ACTIVE_LOW>,
                    <&gpio0 13 GPIO_ACTIVE_LOW>,
                    <&gpio0 12 GPIO_ACTIVE_LOW>,
                    <&gpio0 11 GPIO_ACTIVE_LOW>,
                    <&gpio0 8  GPIO_ACTIVE_LOW>;
    };

    default_transform: matrix_transform {
        compatible = "zmk,matrix-transform";
        rows = <4>;
        columns = <14>;

        // Optional: if you're using a non-standard layout and want to remap
        // physical to logical layout, you can set up a `map` block here.
        // map = <RC(row, col), ...>;
    };
};
